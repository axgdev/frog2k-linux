## buildroot/sf2000_defconfig
```kconfig
BR2_mipsel=y
BR2_mips_32=y
BR2_MIPS_SOFT_FLOAT=y
BR2_OPTIMIZE_S=y
BR2_TAR_OPTIONS="--absolute-names"
BR2_SSP_NONE=y
BR2_STATIC_LIBS=y
BR2_BINFMT_FLAT=y
BR2_BINFMT_FLAT_ONE=y
BR2_TOOLCHAIN_BUILDROOT_UCLIBC=y
BR2_PTHREADS_NONE=y
# BR2_UCLIBC_INSTALL_UTILS is not set
BR2_KERNEL_HEADERS_VERSION=y
BR2_DEFAULT_KERNEL_VERSION="5.12.4"
BR2_PACKAGE_HOST_LINUX_HEADERS_CUSTOM_5_12=y
BR2_INIT_BUSYBOX=y
BR2_SYSTEM_BIN_SH_BUSYBOX=y
BR2_TARGET_GENERIC_HOSTNAME="sf2000"
BR2_TARGET_GENERIC_ISSUE="SF2000 Buildroot Linux"
BR2_TARGET_GENERIC_GETTY_PORT="ttyS0"
BR2_TARGET_GENERIC_GETTY_BAUDRATE_115200=y
# BR2_PACKAGE_URANDOM_SCRIPTS is not set
BR2_TARGET_ROOTFS_CPIO=y
BR2_TARGET_ROOTFS_CPIO_NONE=y
# BR2_TARGET_ROOTFS_TAR is not set
```
